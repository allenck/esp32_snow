## example/3d_show/main/Kconfig.projbuild
```kconfig
menu "ESP32_snow 3d_show Configuration"

menu "WiFi Settings"

choice WIFI_MODE
    bool "Select STA or AP mode"
    default WIFI_MODE_AP
    help
        Select whether STA or AP

config WIFI_MODE_AP
    bool "WiFi AP"
config WIFI_MODE_STA
    bool "WiFi STA"
endchoice

config ESP_WIFI_SSID
    depends on WIFI_MODE_STA
    string "WiFi STA SSID"
    default ""
    help
    WiFi SSID (network name) to connect to or empty for Off.

config ESP_WIFI_PASSWORD
    depends on WIFI_MODE_STA
    string "WiFi STA Password"
    default ""
    help
    WiFi Password if WEP/WPA/WPA2 or empty if Open.
    
config ESP_WIFI_AP_SSID
    depends on WIFI_MODE_AP
    string "WiFi AP SSID"
    default "we"
    help
	AP SSID (network name) to create or empty for Off.

config ESP_WIFI_AP_PASSWORD
    depends on WIFI_MODE_AP
    string "WiFi AP Password"
    default "123456789"
    help
	AP password for WPA2 or empty for Open.

config SERVER_IP
    depends on WIFI_MODE_AP
    string "IP address of server"
    default "192.168.4.1"

config ESP_MAXIMUM_RETRY
    depends on WIFI_MODE_AP
    int "Maximum retry"
    default 5
    help
    Set the Maximum retry to avoid station reconnecting to the AP unlimited when the AP is really inexistent.
endmenu

config LED_PIN
    int "Pin controlling LED"
    range -1 33
    default 5
    help
        Select LED pin or -1 for unmanaged.
endmenu
```

## example/audio_play/main/Kconfig.projbuild
```kconfig
menu "ESP32_SNOW audio_play Config"

choice MP3_DECODE
    prompt "mp3 decode lib choice"
    default CONFIG_AUDIO_MAD
    help
        Select the MP3 decode lib to use.

config AUDIO_MAD
    bool "AUDIO MAD"
    help
        Select mad https://sourceforge.net/projects/mad/files/libmad/

config AUDIO_HELIX
    bool "AUDIO HELIX"
    help
        Select helix https://www.helixcommunity.org/projects/datatype/Mp3dec

endchoice

config LED_PIN
    int "Pin controlling LED"
    range -1 33
    default 5
    help
        Select LED pin or -1 for unmanaged.
endmenu
```

## example/lame_encode/main/Kconfig.projbuild
```kconfig
menu "ESP32_snow lame_encode Configuration"

config LED_PIN
    int "Pin controlling LED"
    range -1 33
    default 5
    help
        Select LED pin or -1 for unmanaged.

endmenu
```

## example/web_server/main/Kconfig.projbuild
```kconfig
menu "ESP32_snow web_server Configuration"

menu "WiFi Settings"
config ESP_WIFI_SSID
    string "WiFi STA SSID"
    default ""
    help
    WiFi SSID (network name) to connect to or empty for Off.

config ESP_WIFI_PASSWORD
    string "WiFi STA Password"
    default ""
    help
    WiFi Password if WEP/WPA/WPA2 or empty if Open.
    
config ESP_WIFI_AP_SSID
    string "WiFi AP SSID"
    default "ESP32-Camera"
    help
	AP SSID (network name) to create or empty for Off.

config ESP_WIFI_AP_PASSWORD
    string "WiFi AP Password"
    default ""
    help
	AP password for WPA2 or empty for Open.

config SERVER_IP
    string "IP address of server"
    default "192.168.4.1"

config ESP_MAXIMUM_RETRY
    int "Maximum retry"
    default 5
    help
    Set the Maximum retry to avoid station reconnecting to the AP unlimited when the AP is really inexistent.
endmenu

config LED_PIN
    int "Pin controlling LED"
    range -1 33
    default 5
    help
        Select LED pin or -1 for unmanaged.

endmenu
```
